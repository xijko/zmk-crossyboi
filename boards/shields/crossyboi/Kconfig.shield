## boards/shields/crossyboi/Kconfig.shield
```kconfig
# No whitespace after the comma or in your part name!
config SHIELD_CROSSYBOI_LEFT
    def_bool $(shields_list_contains,crossyboi_left)

# No whitespace after the comma or in your part name!
config SHIELD_CROSSYBOI_RIGHT
    def_bool $(shields_list_contains,crossyboi_right)
```
