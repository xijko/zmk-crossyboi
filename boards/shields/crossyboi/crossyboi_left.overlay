#include "crossyboi.dtsi"

/{
    chosen {
        zmk,kscan = &default_kscan;
        zmk,matrix_transform = &default_transform;
    };

    default_kscan: kscan {
        compatible = "smk,kscan-gpio-matrix";
        label = "default_kscan";
        diode-direction = "col2row";

        row-gpios = <&promicro 15 (GPIO_ACTIVE_HIGH | GPIO_PULL_DOWN)>,
                    <&promicro 15 (GPIO_ACTIVE_HIGH | GPIO_PULL_DOWN)>,
                    <&promicro 15 (GPIO_ACTIVE_HIGH | GPIO_PULL_DOWN)>,
                    <&promicro 15 (GPIO_ACTIVE_HIGH | GPIO_PULL_DOWN)>,
                    <&promicro 15 (GPIO_ACTIVE_HIGH | GPIO_PULL_DOWN)>,
                    <&promicro 15 (GPIO_ACTIVE_HIGH | GPIO_PULL_DOWN)>;

        col-gpios = <&promicro 15 (GPIO_ACTIVE_HIGH | GPIO_PULL_DOWN)>,
                    <&promicro 15 (GPIO_ACTIVE_HIGH | GPIO_PULL_DOWN)>,
                    <&promicro 15 (GPIO_ACTIVE_HIGH | GPIO_PULL_DOWN)>,
                    <&promicro 15 (GPIO_ACTIVE_HIGH | GPIO_PULL_DOWN)>,
                    <&promicro 15 (GPIO_ACTIVE_HIGH | GPIO_PULL_DOWN)>,
                    <&promicro 15 (GPIO_ACTIVE_HIGH | GPIO_PULL_DOWN)>;

    };

    default_transform = matrix_transform {
        compatible = "zmk,matrix-transform";
        rows = <6>;
        columns = <6>;
        map = <
            RC(0,0) RC(0,1)
            RC(1,0) RC(1,1) RC(1,2) RC(1,3) RC(1,4) RC(1,5)
            RC(2,0) RC(2,1) RC(2,2) RC(2,3) RC(2,4) RC(2,5)
            RC(3,0) RC(3,1) RC(3,2) RC(3,3) RC(3,4) RC(3,5)
            RC(4,0) RC(4,1) RC(4,2) RC(4,3) RC(4,4) RC(4,5)

                                    RC(5,3) RC(5,4) RC(5,5)
        >
    }
}
